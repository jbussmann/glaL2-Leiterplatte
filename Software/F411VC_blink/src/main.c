/*
 ******************************************************************************
 File:     main.c
 Info:     Generated by Atollic TrueSTUDIO(R) 9.2.0   2021-07-14
 ******************************************************************************
 */

/* Includes */
#include "stm32f4xx.h"

/* Private macro */

/* Private variables */

/* Private function prototypes */

/* Private functions */
void initSystick(uint32_t ms)
{
  SysTick_Config((SystemCoreClock / 1000) * ms);
  __enable_irq();
}

void SysTick_Handler(void)
{
  GPIOE->ODR ^= GPIO_ODR_ODR_7;
}

void initI2C3(void)
{
//  PA8: I2C3_SCL (AF04)
//  PC9: I2C3_SDA (AF04)
  /*
   • Program peripheral input clock in I2C_CR2 Register in order to generate
   correct timings
   • Configure clock control registers
   • Configure rise time register
   • Program the I2C_CR1 register to enable the peripheral
   • Set the START bit in the I2C_CR1 register to generate a Start condition
   */

// set pins to AF04
  RCC->AHB1ENR |= RCC_AHB1ENR_GPIOAEN;
  RCC->AHB1ENR |= RCC_AHB1ENR_GPIOCEN;
  GPIOA->MODER |= GPIO_MODER_MODER8_1;
  GPIOC->MODER |= GPIO_MODER_MODER9_1;
  GPIOA->OTYPER |= GPIO_OTYPER_OT_8;
  GPIOC->OTYPER |= GPIO_OTYPER_OT_9;
  GPIOA->AFR[1] |= (4 << 0);
  GPIOC->AFR[1] |= (4 << 4);

  RCC->APB1ENR |= RCC_APB1ENR_I2C3EN;
  // peripheral clock frequency (match APB clock frequency in MHz)
  I2C3->CR2 |= 16;
  // set I2C frequency to 2 * APB / CCR = 100k
  I2C3->CCR |= 320;
  // set rise time to 1000ns / 62.5ns + 1 = 17
  I2C3->TRISE |= 17;
}

void I2Csend(uint8_t chipAddr, uint8_t regAddr, uint8_t data)
{
  /*
   • master generates start condition
   • master sends slave address (7 bits) and data direction bit (R/ W = 0)
   • slave sends acknowledge signal if slave address is correct
   • master sends control register address (8 bits)
   • slave sends acknowledge signal
   • master sends data byte to be written to addressed register
   • slave sends acknowledge signal
   • If master sends further data bytes, control register address of slave is
   incremented by 1 after acknowledge signal. To reduce program load time,
   device supports address auto incrementation. Register address is
   incremented after each 8 data bits.
   • write cycle ends when master device creates stop condition.
   */

  // enable periphery
  I2C3->CR1 |= I2C_CR1_PE; // Peripheral enable
  // generate start condition
  I2C3->CR1 |= I2C_CR1_START; // Start generation
  // wait for Star bit to be set
  while (!(I2C3->SR1 & I2C_SR1_SB))
    ; // Start bit (Master mode)
  // send 7bit slave address and set R/W bit
  I2C3->DR = chipAddr << 1;
  // wait for address to be sent
  while (!(I2C3->SR1 & I2C_SR1_ADDR))
    ; // Address sent (master mode)
  // read status register 2 to clear ADDR bit
  I2C3->SR2;
  // wait for data register to be emptied
  while (!(I2C3->SR1 & I2C_SR1_TXE))
    ; // Data register empty (transmitters)
  // send slave register address
  I2C3->DR = regAddr;
  // generate start condition
//  I2C3->CR1 |= I2C_CR1_START; // Start generation
//  // wait for data register to be emptied
  while (!(I2C3->SR1 & I2C_SR1_TXE))
    ; // Data register empty (transmitters)
  // send slave register data
  I2C3->DR = data;
  // wait for data register to be emptied and byte transfer to be finished
  while (!((I2C3->SR1 & I2C_SR1_TXE) && (I2C3->SR1 & I2C_SR1_BTF)))
    ;
//  // generate start condition
//  I2C3->CR1 |= I2C_CR1_START; // Start generation
  // generate stop condition
  I2C3->CR1 |= I2C_CR1_STOP; // Stop generation
  // disable periphery
  I2C3->CR1 &= ~(I2C_CR1_PE); // Peripheral enable
}

/**
 **===========================================================================
 **
 **  Abstract: main program
 **
 **===========================================================================
 */

int main(void)
{
  /**
   *  IMPORTANT NOTE!
   *  The symbol VECT_TAB_SRAM needs to be defined when building the project
   *  if code has been located to RAM and interrupts are used.
   *  Otherwise the interrupt table located in flash will be used.
   *  See also the <system_*.c> file and how the SystemInit() function updates
   *  SCB->VTOR register.
   *  E.g.  SCB->VTOR = 0x20000000;
   */

  // activate APB and config registers
  RCC->AHB1ENR |= RCC_AHB1ENR_GPIOEEN;
  GPIOE->MODER |= GPIO_MODER_MODER7_0;
  initSystick(1000);

  initI2C3();
  I2Csend(0b0001100, 0x17, 0xFF);
  I2Csend(0b0001100, 0x00, 0b01000000);

  I2Csend(0b0001100, 0x0B, 0x03);
//  I2Csend(0b0001100, 0x0C, 0x02);
//  I2Csend(0b0001100, 0x0D, 0x02);

//  I2Csend(0b0001100, 0x0E, 0x02);
  I2Csend(0b0001100, 0x0F, 0x03);
//  I2Csend(0b0001100, 0x10, 0x02);

//  I2Csend(0b0001100, 0x11, 0x02);
//  I2Csend(0b0001100, 0x12, 0x02);
  I2Csend(0b0001100, 0x13, 0x03);

  I2Csend(0b0001100, 0x14, 0x01);
  I2Csend(0b0001100, 0x15, 0x01);
  I2Csend(0b0001100, 0x16, 0x01);

  /* Infinite loop */
  while (1) {
  }
}
